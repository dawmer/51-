
#include "reg52.h"			 //此文件中定义了单片机的一些特殊功能寄存器
#include "ds1302.h"	
extern uint a[7];
uint sj[12];
extern int i;
void datapros() 	 
{
	int j;
	if(i>=7)
   	Ds1302ReadTime();
	sj[0] = TIME[6]/16;				//年
	sj[1] = TIME[6]&0x0f;
	sj[2] =TIME[4]/16;				//月
	sj[3] = TIME[4]&0x0f;
	sj[4] = TIME[3]/16;				//日
	sj[5] = TIME[3]&0x0f;
	sj[6] = TIME[2]/16;				//时
	sj[7] = TIME[2]&0x0f;				 
	sj[8] = TIME[1]/16;				//分
	sj[9] = TIME[1]&0x0f;	
	sj[10] = TIME[0]/16;				//秒
	sj[11] = TIME[0]&0x0f;
	for(j=0;j<12;j++)
	if(sj[j]>9)
	{
		sj[j]=sj[j]-10;
		sj[j-1]++;
	}
}


/*******************************************************************************
* 函数名         :DigDisplay()
* 函数功能		 :数码管显示函数
* 输入           : 无
* 输出         	 : 无
*****************************************************************************
/*******************************************************************************
* 函 数 名       : main
* 函数功能		 : 主函数
* 输    入       : 无
* 输    出    	 : 无
*******************************************************************************/
void sjh()
{	


		datapros();	 //数据处理函数		
		
}//
